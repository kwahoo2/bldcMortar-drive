## boards/arm/mortar_board2/Kconfig.board
```kconfig
# Copyright (c) 2022 Nordic Semiconductor ASA
# SPDX-License-Identifier: Apache-2.0

config BOARD_MORTAR_BOARD2
	bool "Mortar_Board2"
	depends on SOC_NRF52840_QIAA
```

## boards/arm/mortar_board2/Kconfig.defconfig
```kconfig
# Copyright (c) 2022 Nordic Semiconductor ASA
# SPDX-License-Identifier: Apache-2.0

if BOARD_MORTAR_BOARD2

config BOARD
	default "mortar_board2"

config BT_CTLR
   default BT

endif
```
